LIST P=18F4520 ;directive to define processor
#include <P18F4520.INC> ;CPU specific variable definitions

;----------------------------------------------------------------
;Button list:
;0) Start:              show message "HELLO!"
    ;1) Button 1:       show a message (chinese 1) + (show hourglass)
    ;2) Button 2:       show a message (chinese 2) + (show hourglass)
    ;3) Button 3:       show a message (name & SID) + (show hourglass)
    ;4) Button 4:       show a animation + (show hourglass)
    ;5) Button 5:       show a message (testing) + (show hourglass)
    ;6) Button 6:       set display speed (fast mode) + (show hourglass)
    ;7) Button 7:       set display speed (slow mode) + (show hourglass)
    ;8) Button 8:       (show hourglass) then
    ;   Button8_5:      goto Start
    ;   Button8_8:      show message "EXITING!" + turn off LED + goto Exit
;----------------------------------------------------------------

;Configuration bits definitions
CONFIG OSC = XT
CONFIG WDT = OFF
CONFIG LVP = OFF

;Variable definitions and settings
ORG 0x0000
CBLOCK 0x0010
    BUTTON_DELAY_REG
    MESSAGE_LENGTH_REG_L
    MESSAGE_LENGTH_REG_H
    MESSAGE_LENGTH_REG_FF
    DELAY_IO_VAR
    DISPLAY_HOLD_VAR
    MESSGAE_SPEED_REG
    MESSAGE_GOLBAL_SPEED_VAR
    MESSAGE_special_loop_VAR
    TABLE_location_C_L
    TABLE_location_C_H
    TABLE_location_C_U
    TABLE_location_D_L
    TABLE_location_D_H
    TABLE_location_D_U
    TABLE_counter_L
    TABLE_counter_H
    TABLE_ini_pos_L
    TABLE_ini_pos_H
    LED_inner_loop_VAR
    PORTA_ini_pos_REG
ENDC

;IO settings
movlw 0x0f
movwf ADCON1
setf TRISB                          ;Set Port B direction input
clrf TRISA                          ;Set Port A direction output (3-8 decoder)
clrf TRISC                          ;Set Port C direction output (m1 or m2)
clrf TRISD                          ;Set Port D direction output (m3 or m4)

;Reset vector
goto Start
ORG 0x0080

;Start of main program
Start:
    movlw d'10'                      ;default speed of displaying message: fast mode
    movwf MESSGAE_SPEED_REG
    call Message_HELLO_setting
    call Message_movable

MainLoop: 	
    call Message_loading_arrow
    btfss PORTB, 0
    call Button_P1_function
    btfss PORTB, 1
    call Button_P2_function
    btfss PORTB, 2
    call Button_P3_function
    btfss PORTB, 3
    call Button_P4_function
    btfss PORTB, 4
    call Button_P5_function
    btfss PORTB, 5
    call Button_P6_function
    btfss PORTB, 6
    call Button_P7_function
    btfss PORTB, 7
    call Button_P8_function
goto MainLoop

;Exits the program
Exit: goto Exit 

;*(User_edit)Button 1's setting - set to display message - CHINESE message
Button_P1_function:
    call Message_CHINESE_setting
    call Message_movable
    call Message_loading_hourglass
    wait_up_P1:
        btfss PORTB, 0
        bra wait_up_P1
    call Delay_input
return

;*(User_edit)Button 2's setting - set to display message - CHINESE passgae
Button_P2_function:
    call Message_CHINESE_meme_setting
    call Message_movable
    call Message_loading_hourglass
    wait_up_P2:
        btfss PORTB, 1
        bra wait_up_P2
    call Delay_input
return

;*(User_edit)Button 3's setting - set to display message - ENGLISH info
Button_P3_function:
    call Message_info_setting
    call Message_movable
    call Message_loading_hourglass
    wait_up_P3:
        btfss PORTB, 2
        bra wait_up_P3
    call Delay_input
return

;*(User_edit)Button 4's setting - set to display message - Animation
Button_P4_function:
    call Message_fbf_animate_setting
    call Message_fbf
    call Message_loading_hourglass
    wait_up_P4:
        btfss PORTB, 3
        bra wait_up_P4
    call Delay_input
return

;(User_edit)Button 5's setting - set to display message - Test message
Button_P5_function:
    call Message_test_setting
    call Message_movable
    call Message_loading_hourglass
    wait_up_P5:
        btfss PORTB, 4
        bra wait_up_P5
    call Delay_input
return

;(User_edit)Button 6's setting - toggle the speed of displaying message: fast
Button_P6_function:
    movlw d'10'
    movwf MESSGAE_SPEED_REG
    call Message_fast_setting
    call Message_movable
    call Message_loading_hourglass
    wait_up_P6:
        btfss PORTB, 5
        bra wait_up_P6
    call Delay_input
return

;(User_edit)Button 7's setting - toggle the speed of displaying message: slow
Button_P7_function:
    movlw d'20'
    movwf MESSGAE_SPEED_REG
    call Message_slow_setting
    call Message_movable
    call Message_loading_hourglass
    wait_up_P7:
        btfss PORTB, 6
        bra wait_up_P7
    call Delay_input
return

;(User_edit)Button 8's setting - goto start or exit
Button_P8_function:
    call Message_loading_hourglass
    btfss PORTB, 4
    call Button_P8_braMAIN
    btfss PORTB, 7
    call Button_P8_braEXIT
    bra Button_P8_function
return

;(User_edit)Button 8_5's setting - goto start
Button_P8_braMAIN:
    btfss PORTB, 4
    bra Button_P8_braMAIN
    bra Start
return

;(User_edit)Button 8_8's setting - goto exit
Button_P8_braEXIT:
    call Message_EXITING_setting
    call Message_movable
    call Message_null_setting
    call Message_fbf
    bra Exit
return

;()Delay time between button's signal
Delay_input:
    movlw 0x28
    movwf BUTTON_DELAY_REG
    Delay_input_2:
        decf BUTTON_DELAY_REG, f
        bnz Delay_input_2
return

;()Display right to left moving message
Message_movable:
    incf MESSAGE_LENGTH_REG_L, f
    movlw 0x00
    addwfc MESSAGE_LENGTH_REG_H
    Message_movable_not_FF:
        call Message_display_repeat
        incf TABLE_ini_pos_L, f
        movlw 0x00
        addwfc TABLE_ini_pos_H
        decf MESSAGE_LENGTH_REG_L, f
        bnz Message_movable_not_FF
    tstfsz MESSAGE_LENGTH_REG_H
    call Message_movable_inner
return

;()Display right to left moving message - inner loop 256 times (if length > 255)
Message_movable_inner:
    clrf MESSAGE_LENGTH_REG_FF
    Message_movable_FF:
        call Message_display_repeat
        incf TABLE_ini_pos_L, f
        movlw 0x00
        addwfc TABLE_ini_pos_H
        decf MESSAGE_LENGTH_REG_FF, f
        bnz Message_movable_FF
    decf MESSAGE_LENGTH_REG_H, f
    bnz Message_movable_inner
return

;()Display animation message
Message_fbf:
    call Message_display_repeat
    movlw 0x10
    addwf TABLE_ini_pos_L
    movlw 0x00
    addwfc TABLE_ini_pos_H
    decf MESSAGE_LENGTH_REG_L, f
    bnz Message_fbf
return

;()Display loading message - hourglass (default: display 2 times with speed 5)
Message_loading_hourglass:
    movff MESSGAE_SPEED_REG, MESSAGE_GOLBAL_SPEED_VAR
    movlw d'5'
    movwf MESSGAE_SPEED_REG
    movlw d'2'
    movwf MESSAGE_special_loop_VAR
    Message_loading_hourglass_inner:
        call Message_fbf_hourglass_setting
        call Message_fbf
        decf MESSAGE_special_loop_VAR
        bnz Message_loading_hourglass_inner
    movff MESSAGE_GOLBAL_SPEED_VAR, MESSGAE_SPEED_REG
return

;()Display loading message arrow (default: display 1 time with speed 5)
Message_loading_arrow:
    movff MESSGAE_SPEED_REG, MESSAGE_GOLBAL_SPEED_VAR
    movlw d'5'
    movwf MESSGAE_SPEED_REG
    call Message_fbf_arrow_setting
    call Message_fbf
    movff MESSAGE_GOLBAL_SPEED_VAR, MESSGAE_SPEED_REG
return

;()Delay time between LED's on-off (default: set to 0x40)
Delay_output:		
    movlw 0x40
    movwf DELAY_IO_VAR
    Delay_output_2:	
        decf DELAY_IO_VAR, f
        bnz Delay_output_2
return

;()Display message repeatly with n times to show up
Message_display_repeat:
    movff MESSGAE_SPEED_REG, DISPLAY_HOLD_VAR
    Message_display_repeat_2:	
        clrf TABLE_counter_L
        clrf TABLE_counter_H
        movff TABLE_ini_pos_L, TABLE_counter_L
        movff TABLE_ini_pos_H, TABLE_counter_H
        movlw 0x10 
        movwf PORTA_ini_pos_REG
        call Message_display_inner_loop
        movlw 0x08
        movwf PORTA_ini_pos_REG
        call Message_display_inner_loop
        decf DISPLAY_HOLD_VAR, f
        bnz Message_display_repeat_2
return

;()Display message repeatly function - inner loop
Message_display_inner_loop:
    movlw 0x08
    movwf LED_inner_loop_VAR
    Message_display_inner_loop_1:
        movff PORTA_ini_pos_REG, PORTA
        clrf PORTC
        clrf PORTD
        call look_up_table_C
        movwf PORTC
        call look_up_table_D
        movwf PORTD
        incf TABLE_counter_L, f
        movlw 0x00
        addwfc TABLE_counter_H
        incf PORTA_ini_pos_REG ,f
        call Delay_output
        decf LED_inner_loop_VAR, f
        bnz Message_display_inner_loop_1
return

;()Look-up table function for message upper part
look_up_table_C:  
    movff TABLE_location_C_L, TBLPTRL
    movff TABLE_location_C_H, TBLPTRH
    movff TABLE_location_C_U, TBLPTRU
    movf TABLE_counter_L, w
    addwf TBLPTRL
    movf TABLE_counter_H, w
    addwfc TBLPTRH
    movlw 0x00
    addwfc TBLPTRU
    TBLRD*
    movf TABLAT, w
return

;()Look-up table function for message lower part
look_up_table_D:  
    movff TABLE_location_D_L, TBLPTRL
    movff TABLE_location_D_H, TBLPTRH
    movff TABLE_location_D_U, TBLPTRU
    movf TABLE_counter_L, w
    addwf TBLPTRL
    movf TABLE_counter_H, w
    addwfc TBLPTRH
    movlw 0x00
    addwfc TBLPTRU
    TBLRD*
    movf TABLAT, w
return

;Message settings and message's data tables

;(User_edit)Message CHINESE message's setting (array method)
Message_CHINESE_setting:   
    movlw d'2'
    movwf MESSAGE_LENGTH_REG_H
    movlw d'176'
    movwf MESSAGE_LENGTH_REG_L                  ;items in table - 16
    clrf TABLE_ini_pos_L
    clrf TABLE_ini_pos_H
    movlw low table_message_CHINESE_C_data      ;set the location of table reader C
    movwf TABLE_location_C_L
    movlw high table_message_CHINESE_C_data
    movwf TABLE_location_C_H
    movlw upper table_message_CHINESE_C_data
    movwf TABLE_location_C_U
    movlw low table_message_CHINESE_D_data      ;set the location of table reader D
    movwf TABLE_location_D_L
    movlw high table_message_CHINESE_D_data
    movwf TABLE_location_D_H
    movlw upper table_message_CHINESE_D_data
    movwf TABLE_location_D_U
return

;(User_edit)Message CHINESE passgae's setting (array method)
Message_CHINESE_meme_setting:   
    movlw d'8'
    movwf MESSAGE_LENGTH_REG_H
    movlw d'48'
    movwf MESSAGE_LENGTH_REG_L                  ;items in table - 16
    clrf TABLE_ini_pos_L
    clrf TABLE_ini_pos_H
    movlw low table_message_C_meme_C_data       ;set the location of table reader C
    movwf TABLE_location_C_L
    movlw high table_message_C_meme_C_data
    movwf TABLE_location_C_H
    movlw upper table_message_C_meme_C_data
    movwf TABLE_location_C_U
    movlw low table_message_C_meme_D_data       ;set the location of table reader D
    movwf TABLE_location_D_L
    movlw high table_message_C_meme_D_data
    movwf TABLE_location_D_H
    movlw upper table_message_C_meme_D_data
    movwf TABLE_location_D_U
return

;(User_edit)Message ENGLISH info's setting (array method)
Message_info_setting:   
    movlw d'2'
    movwf MESSAGE_LENGTH_REG_H
    movlw d'108'
    movwf MESSAGE_LENGTH_REG_L                  ;items in table - 16
    clrf TABLE_ini_pos_L
    clrf TABLE_ini_pos_H
    movlw low table_message_info_C_data         ;set the location of table reader C
    movwf TABLE_location_C_L
    movlw high table_message_info_C_data
    movwf TABLE_location_C_H
    movlw upper table_message_info_C_data
    movwf TABLE_location_C_U
    movlw low table_message_info_D_data         ;set the location of table reader D
    movwf TABLE_location_D_L
    movlw high table_message_info_D_data
    movwf TABLE_location_D_H
    movlw upper table_message_info_D_data
    movwf TABLE_location_D_U
return

;(User_edit)Message Animation's setting (animation method)
Message_fbf_animate_setting:   
    clrf MESSAGE_LENGTH_REG_H
    movlw d'96'
    movwf MESSAGE_LENGTH_REG_L                  ;number of frames to animate
    clrf TABLE_ini_pos_L
    clrf TABLE_ini_pos_H
    movlw low table_animate_C_data              ;set the location of table reader C
    movwf TABLE_location_C_L
    movlw high table_animate_C_data
    movwf TABLE_location_C_H
    movlw upper table_animate_C_data
    movwf TABLE_location_C_U
    movlw low table_animate_D_data              ;set the location of table reader D
    movwf TABLE_location_D_L
    movlw high table_animate_D_data
    movwf TABLE_location_D_H
    movlw upper table_animate_D_data
    movwf TABLE_location_D_U
return

;(User_edit)Message hello's setting (array method)
Message_HELLO_setting:   
    clrf MESSAGE_LENGTH_REG_H
    movlw d'64'
    movwf MESSAGE_LENGTH_REG_L                  ;items in table - 16
    clrf TABLE_ini_pos_L
    clrf TABLE_ini_pos_H
    movlw low table_message_HELLO_C_data        ;set the location of table reader C
    movwf TABLE_location_C_L
    movlw high table_message_HELLO_C_data
    movwf TABLE_location_C_H
    movlw upper table_message_HELLO_C_data
    movwf TABLE_location_C_U
    movlw low table_message_HELLO_D_data        ;set the location of table reader D
    movwf TABLE_location_D_L
    movlw high table_message_HELLO_D_data
    movwf TABLE_location_D_H
    movlw upper table_message_HELLO_D_data
    movwf TABLE_location_D_U
return

;(User_edit)Message exiting's setting (array method)
Message_EXITING_setting:   
    clrf MESSAGE_LENGTH_REG_H
    movlw d'80'
    movwf MESSAGE_LENGTH_REG_L                  ;items in table - 16
    clrf TABLE_ini_pos_L
    clrf TABLE_ini_pos_H
    movlw low table_message_EXITING_C_data      ;set the location of table reader C
    movwf TABLE_location_C_L
    movlw high table_message_EXITING_C_data
    movwf TABLE_location_C_H
    movlw upper table_message_EXITING_C_data
    movwf TABLE_location_C_U
    movlw low table_message_EXITING_D_data      ;set the location of table reader D
    movwf TABLE_location_D_L
    movlw high table_message_EXITING_D_data
    movwf TABLE_location_D_H
    movlw upper table_message_EXITING_D_data
    movwf TABLE_location_D_U
return

;(User_edit)Message Test message's setting (array method)
Message_test_setting:   
    movlw d'1'
    movwf MESSAGE_LENGTH_REG_H
    movlw d'120'
    movwf MESSAGE_LENGTH_REG_L                  ;items in table - 16
    clrf TABLE_ini_pos_L
    clrf TABLE_ini_pos_H
    movlw low table_test_messgae_C_data         ;set the location of table reader C
    movwf TABLE_location_C_L
    movlw high table_test_messgae_C_data
    movwf TABLE_location_C_H
    movlw upper table_test_messgae_C_data
    movwf TABLE_location_C_U
    movlw low table_test_messgae_D_data         ;set the location of table reader D
    movwf TABLE_location_D_L
    movlw high table_test_messgae_D_data
    movwf TABLE_location_D_H
    movlw upper table_test_messgae_D_data
    movwf TABLE_location_D_U
return

;(User_edit)Message fast mode's setting (array method)
Message_fast_setting:   
    clrf MESSAGE_LENGTH_REG_H
    movlw d'140'
    movwf MESSAGE_LENGTH_REG_L                  ;items in table - 16
    clrf TABLE_ini_pos_L
    clrf TABLE_ini_pos_H
    movlw low table_fast_C_data                 ;set the location of table reader C
    movwf TABLE_location_C_L
    movlw high table_fast_C_data
    movwf TABLE_location_C_H
    movlw upper table_fast_C_data
    movwf TABLE_location_C_U
    movlw low table_fast_D_data                 ;set the location of table reader D
    movwf TABLE_location_D_L
    movlw high table_fast_D_data
    movwf TABLE_location_D_H
    movlw upper table_fast_D_data
    movwf TABLE_location_D_U
return

;(User_edit)Message slow mode's setting (array method)
Message_slow_setting:   
    clrf MESSAGE_LENGTH_REG_H
    movlw d'152'
    movwf MESSAGE_LENGTH_REG_L                  ;items in table - 16
    clrf TABLE_ini_pos_L
    clrf TABLE_ini_pos_H
    movlw low table_slow_C_data                 ;set the location of table reader C
    movwf TABLE_location_C_L
    movlw high table_slow_C_data
    movwf TABLE_location_C_H
    movlw upper table_slow_C_data
    movwf TABLE_location_C_U
    movlw low table_slow_D_data                 ;set the location of table reader D
    movwf TABLE_location_D_L
    movlw high table_slow_D_data
    movwf TABLE_location_D_H
    movlw upper table_slow_D_data
    movwf TABLE_location_D_U
return

;(User_edit)Message null's setting (animation method)
Message_null_setting:   
    clrf MESSAGE_LENGTH_REG_H
    movlw d'1'
    movwf MESSAGE_LENGTH_REG_L                  ;number of frames to animate
    clrf TABLE_ini_pos_L
    clrf TABLE_ini_pos_H
    movlw low table_NULL                        ;set the location of table reader C & D
    movwf TABLE_location_C_L
    movwf TABLE_location_D_L
    movlw high table_NULL
    movwf TABLE_location_C_H
    movwf TABLE_location_D_H
    movlw upper table_NULL
    movwf TABLE_location_C_U
    movwf TABLE_location_D_U
return

;(User_edit)Message arrow's setting (animation method)
Message_fbf_arrow_setting:   
    clrf MESSAGE_LENGTH_REG_H
    movlw d'8'
    movwf MESSAGE_LENGTH_REG_L                  ;number of frames to animate
    clrf TABLE_ini_pos_L
    clrf TABLE_ini_pos_H
    movlw low table_arrow_C_data                ;set the location of table reader C
    movwf TABLE_location_C_L
    movlw high table_arrow_C_data
    movwf TABLE_location_C_H
    movlw upper table_arrow_C_data
    movwf TABLE_location_C_U
    movlw low table_arrow_D_data                ;set the location of table reader D
    movwf TABLE_location_D_L
    movlw high table_arrow_D_data
    movwf TABLE_location_D_H
    movlw upper table_arrow_D_data
    movwf TABLE_location_D_U
return

;(User_edit)Message hourglass's setting (animation method)
Message_fbf_hourglass_setting:   
    clrf MESSAGE_LENGTH_REG_H
    movlw d'24'
    movwf MESSAGE_LENGTH_REG_L                  ;number of frames to animate
    clrf TABLE_ini_pos_L
    clrf TABLE_ini_pos_H
    movlw low table_hourglass_C_data            ;set the location of table reader C
    movwf TABLE_location_C_L
    movlw high table_hourglass_C_data
    movwf TABLE_location_C_H
    movlw upper table_hourglass_C_data
    movwf TABLE_location_C_U
    movlw low table_hourglass_D_data            ;set the location of table reader D
    movwf TABLE_location_D_L
    movlw high table_hourglass_D_data
    movwf TABLE_location_D_H
    movlw upper table_hourglass_D_data
    movwf TABLE_location_D_U
return

;(important) The following codes are the data of the messages

ORG 0x4000
;Message CHINESE message
table_message_CHINESE_C_data
    ;Data tables for message CHINESE message upper part
    db 0x00, 0x00, 0x00, 0x00, 0x00, 0x00, 0x00, 0x00       ;space
    db 0x00, 0x00, 0x00, 0x00, 0x00, 0x00, 0x00, 0x00       ;space
    db 0xc0, 0x60, 0xf8, 0xff, 0x07, 0x30, 0x38, 0x1f
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    db 0x00, 0x00, 0x00, 0x00, 0x00, 0x00, 0x00, 0x00       ;space

table_message_CHINESE_D_data
    ;Data tables for message CHINESE message lower part
    db 0x00, 0x00, 0x00, 0x00, 0x00, 0x00, 0x00, 0x00       ;space
    db 0x00, 0x00, 0x00, 0x00, 0x00, 0x00, 0x00, 0x00       ;space
    db 0x00, 0x00, 0x7f, 0x7f, 0x00, 0x1c, 0x0f, 0x23
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    db 0x00, 0x00, 0x00, 0x00, 0x00, 0x00, 0x00, 0x00       ;space

;Message CHINESE passgae
table_message_C_meme_C_data
    ;Data tables for message CHINESE passgae upper part
    db 0x00, 0x00, 0x00, 0x00, 0x00, 0x00, 0x00, 0x00       ;space
    db 0x00, 0x00, 0x00, 0x00, 0x00, 0x00, 0x00, 0x00       ;space
    db 0xf8, 0x00, 0xff, 0xff, 0x30, 0x18, 0xc0, 0x78
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    db 0x00, 0x00, 0x00, 0x00, 0x00, 0x00, 0x00, 0x00       ;space

table_message_C_meme_D_data
    ;Data tables for message CHINESE passgae lower part
    db 0x00, 0x00, 0x00, 0x00, 0x00, 0x00, 0x00, 0x00
    db 0x00, 0x00, 0x00, 0x00, 0x00, 0x00, 0x00, 0x00       ;space
    db 0x60, 0x38, 0x1f, 0x03, 0x06, 0x4c, 0x40, 0x60
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    db 0x00, 0x00, 0x00, 0x00, 0x00, 0x00, 0x00, 0x00       ;space

;Message ENGLISH info
table_message_info_C_data
    ;Data tables for message ENGLISH info upper part
    db 0x00, 0x00, 0x00, 0x00, 0x00, 0x00, 0x00, 0x00       ;space
    db 0x00, 0x00, 0x00, 0x00, 0x00, 0x00, 0x00, 0x00       ;space
    db 0xc0, 0xfc, 0x7f, 0x7f, 0xfc, 0xfc, 0x7f, 0x7f       ;M +
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    db 0x83, 0x83, 0x00, 0x00, 0xff, 0xff, 0x83, 0x83       ;E
    db 0x83, 0x83, 0x00, 0x00, 0x18, 0x1e, 0x0f, 0xcf       ;2
    db 0xfe, 0x78, 0x00, 0x00, 0xf8, 0xfe, 0x0f, 0x0f       ;0
    db 0xfe, 0xf8, 0x00, 0x00, 0xf8, 0xfe, 0x0f, 0x0f       ;0
    db 0xfe, 0xf8, 0x00, 0x00, 0x80, 0xe0, 0xfc, 0x3f       ;4
    db 0xff, 0xff, 0x00, 0x00, 0x00, 0x00, 0x00, 0x00       ;space
    db 0x00, 0x00, 0x00, 0x00, 0xff, 0xff, 0x8f, 0xcf       ;p
    db 0xfe, 0x78, 0x00, 0x00, 0xff, 0xff, 0x8f, 0xcf       ;R
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    db 0x07, 0x00, 0x00, 0x00, 0x78, 0xfe, 0xcf, 0x8f       ;(
    db 0x9e, 0x18, 0x00, 0x00, 0x03, 0x03, 0xff, 0xff       ;S
    db 0x03, 0x03, 0x00, 0x00, 0xff, 0xff, 0x07, 0x0f       ;I
    db 0xfe, 0xf8, 0x00, 0x00, 0x00, 0x3c, 0x3c, 0x3c       ;D
    db 0x3c, 0x00, 0x00, 0x00, 0x00, 0x00, 0x00, 0x00       ;:
    db 0x00, 0x00, 0x00, 0x00, 0x7f, 0xff, 0xc3, 0xc3       ;space
    db 0xc3, 0x03, 0x00, 0x00, 0xf8, 0xfe, 0xcf, 0xcf       ;5
    db 0x9e, 0x18, 0x00, 0x00, 0xf8, 0xfe, 0x0f, 0x0f       ;6
    db 0xfe, 0xf8, 0x00, 0x00, 0x80, 0xe0, 0xfc, 0x3f       ;0
    db 0xff, 0xff, 0x00, 0x00, 0xf8, 0xfe, 0xcf, 0xcf       ;4
    db 0x9e, 0x18, 0x00, 0x00, 0xf8, 0xfe, 0xcf, 0xcf       ;6
    db 0x9e, 0x18, 0x00, 0x00, 0x78, 0xfe, 0xcf, 0xcf       ;6
    db 0xfe, 0x78, 0x00, 0x00, 0xf8, 0xfe, 0x0f, 0x0f       ;8
    db 0xfe, 0xf8, 0x00, 0x00, 0x00, 0x07, 0x3f, 0xfc       ;0
    db 0xf0, 0x00, 0x00, 0x00, 0x00, 0x00, 0x00, 0x00       ;)
    db 0x00, 0x00, 0x00, 0x00, 0x00, 0x00, 0x00, 0x00       ;space
    db 0x00, 0x00, 0x00, 0x00

table_message_info_D_data
    ;Data tables for message ENGLISH info upper part
    db 0x00, 0x00, 0x00, 0x00, 0x00, 0x00, 0x00, 0x00       ;space
    db 0x00, 0x00, 0x00, 0x00, 0x00, 0x00, 0x00, 0x00       ;space
    db 0xff, 0xff, 0x00, 0x00, 0xff, 0xff, 0x00, 0x00       ;M +
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    db 0xc1, 0xc1, 0x00, 0x00, 0xf8, 0xfe, 0xcf, 0xc3       ;E
    db 0xc0, 0xc0, 0x00, 0x00, 0x1f, 0x7f, 0xf0, 0xf0       ;2
    db 0x7f, 0x1f, 0x00, 0x00, 0x1f, 0x7f, 0xf0, 0xf0       ;0
    db 0x7f, 0x1f, 0x00, 0x00, 0x03, 0x03, 0x03, 0x03       ;0
    db 0xff, 0xff, 0x00, 0x00, 0x00, 0x00, 0x00, 0x00       ;4
    db 0x00, 0x00, 0x00, 0x00, 0xff, 0xff, 0x01, 0x01       ;space
    db 0x00, 0x00, 0x00, 0x00, 0xff, 0xff, 0x03, 0x0f       ;P
    db 0xfe, 0xf8, 0x00, 0x00, 0x1f, 0x7f, 0xf0, 0xf0       ;R
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    db 0xe0, 0x00, 0x00, 0x00, 0x18, 0x79, 0xf1, 0xf3       ;(
    db 0x7f, 0x1e, 0x00, 0x00, 0xc0, 0xc0, 0xff, 0xff       ;S
    db 0xc0, 0xc0, 0x00, 0x00, 0xff, 0xff, 0xe0, 0xf0       ;I
    db 0x7f, 0x1f, 0x00, 0x00, 0x00, 0x3c, 0x3c, 0x3c       ;D
    db 0x3c, 0x00, 0x00, 0x00, 0x00, 0x00, 0x00, 0x00       ;:
    db 0x00, 0x00, 0x00, 0x00, 0x18, 0x78, 0xf0, 0xf3       ;space
    db 0x7f, 0x1f, 0x00, 0x00, 0x1f, 0x7f, 0xf3, 0xf3       ;5
    db 0x7f, 0x1e, 0x00, 0x00, 0x1f, 0x7f, 0xf0, 0xf0       ;6
    db 0x7f, 0x1f, 0x00, 0x00, 0x03, 0x03, 0x03, 0x03       ;0
    db 0xff, 0xff, 0x00, 0x00, 0x1f, 0x7f, 0xf3, 0xf3       ;4
    db 0x7f, 0x1e, 0x00, 0x00, 0x1f, 0x7f, 0xf3, 0xf3       ;6
    db 0x7f, 0x1e, 0x00, 0x00, 0x3c, 0x7f, 0xf3, 0xf3       ;6
    db 0x7f, 0x3c, 0x00, 0x00, 0x1f, 0x7f, 0xf0, 0xf0       ;8
    db 0x7f, 0x1f, 0x00, 0x00, 0x00, 0xe0, 0xfc, 0x3f       ;0
    db 0x0f, 0x00, 0x00, 0x00, 0x00, 0x00, 0x00, 0x00       ;)
    db 0x00, 0x00, 0x00, 0x00, 0x00, 0x00, 0x00, 0x00       ;space
    db 0x00, 0x00, 0x00, 0x00

;Message Animation
table_animate_C_data
    ;Data tables for message Animation upper part
    db 0x00, 0x00, 0x00, 0x00, 0x00, 0x00, 0x00, 0x80
    db 0x80, 0x00, 0x00, 0x00, 0x00, 0x00, 0x00, 0x00
    db 0x00, 0x00, 0x00, 0x00, 0x00, 0x00, 0xc0, 0x80
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    db 0x00, 0x00, 0x00, 0x00, 0x00, 0x00, 0x00, 0x00       ;frame 96

table_animate_D_data
    ;Data tables for message Animation lower part
    db 0x00, 0x00, 0x00, 0x00, 0x00, 0x00, 0x00, 0x01
    db 0x01, 0x00, 0x00, 0x00, 0x00, 0x00, 0x00, 0x00
    db 0x00, 0x00, 0x00, 0x00, 0x00, 0x00, 0x02, 0x03
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    db 0x00, 0x00, 0x00, 0x00, 0x00, 0x00, 0x00, 0x00       ;frame 96

;Message HELLO
table_message_HELLO_C_data
    ;Data tables for message HELLO upper part
    db 0x00, 0x00, 0x00, 0x00, 0x00, 0x00, 0x00, 0x00       ;space
    db 0x00, 0x00, 0x00, 0x00, 0x00, 0x00, 0x00, 0x00       ;space
    db 0xff, 0xff, 0x80, 0x80, 0xff, 0xff, 0x00, 0x00       ;H
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    db 0x00, 0x00, 0x00, 0x00, 0x00, 0x00, 0x00, 0x00       ;space

table_message_HELLO_D_data
    ;Data tables for message HELLO lower part
    db 0x00, 0x00, 0x00, 0x00, 0x00, 0x00, 0x00, 0x00       ;space
    db 0x00, 0x00, 0x00, 0x00, 0x00, 0x00, 0x00, 0x00       ;space
    db 0xff, 0xff, 0x01, 0x01, 0xff, 0xff, 0x00, 0x00       ;H
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    db 0x00, 0x00, 0x00, 0x00, 0x00, 0x00, 0x00, 0x00       ;space

;Message BYE
table_message_EXITING_C_data
    ;Data tables for message BYE upper part
    db 0x00, 0x00, 0x00, 0x00, 0x00, 0x00, 0x00, 0x00       ;space
    db 0x00, 0x00, 0x00, 0x00, 0x00, 0x00, 0x00, 0x00       ;space
    db 0xff, 0xff, 0x83, 0x83, 0x83, 0x83, 0x00, 0x00       ;E
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    db 0x00, 0x00, 0x00, 0x00, 0x00, 0x00, 0x00, 0x00       ;space

table_message_EXITING_D_data
    ;Data tables for message BYE lower part
    db 0x00, 0x00, 0x00, 0x00, 0x00, 0x00, 0x00, 0x00       ;space
    db 0x00, 0x00, 0x00, 0x00, 0x00, 0x00, 0x00, 0x00       ;space
    db 0xff, 0xff, 0xc1, 0xc1, 0xc1, 0xc1, 0x00, 0x00       ;E
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    db 0x00, 0x00, 0x00, 0x00, 0x00, 0x00, 0x00, 0x00       ;space

;Message Test message
table_test_messgae_C_data
    ;Data tables for Test message upper part
    db 0x00, 0x00, 0x00, 0x00, 0x00, 0x00, 0x00, 0x00       ;space
    db 0x00, 0x00, 0x00, 0x00, 0x00, 0x00, 0x00, 0x00       ;space
    db 0xf8, 0xfe, 0x8f, 0x8f, 0xfe, 0xf8, 0x00, 0x00       ;A
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    db 0x18, 0x1e, 0x0f, 0xcf, 0xfe, 0x78, 0x00, 0x00       ;?
    db 0x30, 0x3c, 0xff, 0xff, 0x00, 0x00, 0x00, 0x00       ;1
    db 0x18, 0x1e, 0x0f, 0xcf, 0xfe, 0x78, 0x00, 0x00       ;2
    db 0x18, 0x1e, 0x8f, 0xcf, 0xfe, 0x78, 0x00, 0x00       ;3 //
    db 0x80, 0xe0, 0xfc, 0x3f, 0xff, 0xff, 0x00, 0x00       ;4
    db 0x7f, 0xff, 0xc3, 0xc3, 0xc3, 0x03, 0x00, 0x00       ;5
    db 0xf8, 0xfe, 0xcf, 0xcf, 0x9e, 0x18, 0x00, 0x00       ;6
    db 0x03, 0x03, 0x03, 0xc3, 0xff, 0xff, 0x00, 0x00       ;7
    db 0x78, 0xfe, 0xcf, 0xcf, 0xfe, 0x78, 0x00, 0x00       ;8
    db 0x78, 0xfe, 0xcf, 0xcf, 0xfe, 0xf8, 0x00, 0x00       ;9
    db 0xf8, 0xfe, 0x0f, 0x0f, 0xfe, 0xf8, 0x00, 0x00       ;0
    db 0x00, 0x3c, 0x3c, 0x3c, 0x3c, 0x00, 0x00, 0x00       ;:
    db 0xc0, 0xc0, 0xc0, 0xc0, 0xc0, 0xc0, 0x00, 0x00       ;-
    db 0x00, 0xf0, 0xfc, 0x3f, 0x07, 0x00, 0x00, 0x00       ;(
    db 0x00, 0x07, 0x3f, 0xfc, 0xf0, 0x00, 0x00, 0x00       ;)
    db 0x00, 0x3e, 0xff, 0xf3, 0xf0, 0x00, 0x00, 0x00       ;'left
    db 0x00, 0x0f, 0xcf, 0xff, 0x7c, 0x00, 0x00, 0x00       ;'right
    db 0x00, 0x00, 0x00, 0x00, 0x00, 0x00, 0x00, 0x00       ;space
    db 0x00, 0x00, 0x00, 0x00, 0x00, 0x00, 0x00, 0x00       ;space

table_test_messgae_D_data
    ;Data tables for test message lower part
    db 0x00, 0x00, 0x00, 0x00, 0x00, 0x00, 0x00, 0x00       ;space
    db 0x00, 0x00, 0x00, 0x00, 0x00, 0x00, 0x00, 0x00       ;space
    db 0xff, 0xff, 0x03, 0x03, 0xff, 0xff, 0x00, 0x00       ;A
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    db 0x00, 0x00, 0xcf, 0xcf, 0x01, 0x00, 0x00, 0x00       ;?
    db 0xc0, 0xc0, 0xff, 0xff, 0xc0, 0xc0, 0x00, 0x00       ;1
    db 0xf8, 0xfe, 0xcf, 0xc3, 0xc0, 0xc0, 0x00, 0x00       ;2
    db 0x18, 0x78, 0xf1, 0xf3, 0x7f, 0x3c, 0x00, 0x00       ;3 //
    db 0x03, 0x03, 0x03, 0x03, 0xff, 0xff, 0x00, 0x00       ;4
    db 0x18, 0x78, 0xf0, 0xf3, 0x7f, 0x1f, 0x00, 0x00       ;5
    db 0x1f, 0x7f, 0xf3, 0xf3, 0x7f, 0x1e, 0x00, 0x00       ;6
    db 0x00, 0x00, 0xf8, 0xff, 0x0f, 0x00, 0x00, 0x00       ;7
    db 0x3c, 0x7f, 0xf3, 0xf3, 0x7f, 0x3c, 0x00, 0x00       ;8
    db 0x18, 0x79, 0xf3, 0xf3, 0x7f, 0x1f, 0x00, 0x00       ;9
    db 0x1f, 0x7f, 0xf0, 0xf0, 0x7f, 0x1f, 0x00, 0x00       ;0
    db 0x00, 0x3c, 0x3c, 0x3c, 0x3c, 0x00, 0x00, 0x00       ;:
    db 0x03, 0x03, 0x03, 0x03, 0x03, 0x03, 0x00, 0x00       ;-
    db 0x00, 0x0f, 0x3f, 0xfc, 0xe0, 0x00, 0x00, 0x00       ;(
    db 0x00, 0xe0, 0xfc, 0x3f, 0x0f, 0x00, 0x00, 0x00       ;)
    db 0x00, 0x00, 0x00, 0x00, 0x00, 0x00, 0x00, 0x00       ;'left
    db 0x00, 0x00, 0x00, 0x00, 0x00, 0x00, 0x00, 0x00       ;'right
    db 0x00, 0x00, 0x00, 0x00, 0x00, 0x00, 0x00, 0x00       ;space
    db 0x00, 0x00, 0x00, 0x00, 0x00, 0x00, 0x00, 0x00       ;space

;Message fast mode
table_fast_C_data
    ;Data tables for message fast mode upper part
    db 0x00, 0x00, 0x00, 0x00, 0x00, 0x00, 0x00, 0x00       ;space
    db 0x00, 0x00, 0x00, 0x00, 0x00, 0x00, 0x00, 0x00       ;space
    db 0xc0, 0xfc, 0x7f, 0x7f, 0xfc, 0xfc, 0x7f, 0x7f       ;M
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    db 0x00, 0x00, 0x00, 0x00                               ;/space

table_fast_D_data
    ;Data tables for message fast mode lower part
    db 0x00, 0x00, 0x00, 0x00, 0x00, 0x00, 0x00, 0x00       ;space
    db 0x00, 0x00, 0x00, 0x00, 0x00, 0x00, 0x00, 0x00       ;space
    db 0xff, 0xff, 0x00, 0x00, 0xff, 0xff, 0x00, 0x00       ;M 
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    db 0x00, 0x00, 0x00, 0x00                               ;space

;Message slow mode
table_slow_C_data
    ;Data tables for message slow mode upper part
    db 0x00, 0x00, 0x00, 0x00, 0x00, 0x00, 0x00, 0x00       ;space
    db 0x00, 0x00, 0x00, 0x00, 0x00, 0x00, 0x00, 0x00       ;space
    db 0xc0, 0xfc, 0x7f, 0x7f, 0xfc, 0xfc, 0x7f, 0x7f       ;M 
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    db 0x00, 0xf0, 0xfc, 0x3f, 0x07, 0x00, 0x00, 0x00       ;(
    db 0xff, 0xff, 0x07, 0x0f, 0xfe, 0xf8, 0x00, 0x00       ;D
    db 0x00, 0x3e, 0xff, 0xf3, 0xf0, 0x00, 0x00, 0x00       ;'left
    db 0x18, 0x1e, 0x0f, 0xcf, 0xfe, 0x78, 0x00, 0x00       ;2
    db 0xf8, 0xfe, 0x0f, 0x0f, 0xfe, 0xf8, 0x00, 0x00       ;0
    db 0x00, 0x0f, 0xcf, 0xff, 0x7c, 0x00, 0x00, 0x00       ;'right
    db 0x00, 0x07, 0x3f, 0xfc, 0xf0, 0x00, 0x00, 0x00       ;)
    db 0x00, 0x00, 0x00, 0x00, 0x00, 0x00, 0x00, 0x00       ;space
    db 0x00, 0x00, 0x00, 0x00, 0x00, 0x00, 0x00, 0x00       ;space

table_slow_D_data
    ;Data tables for message slow mode lower part
    db 0x00, 0x00, 0x00, 0x00, 0x00, 0x00, 0x00, 0x00       ;space
    db 0x00, 0x00, 0x00, 0x00, 0x00, 0x00, 0x00, 0x00       ;space
    db 0xff, 0xff, 0x00, 0x00, 0xff, 0xff, 0x00, 0x00       ;M
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    db 0x00, 0x0f, 0x3f, 0xfc, 0xe0, 0x00, 0x00, 0x00       ;(
    db 0xff, 0xff, 0xe0, 0xf0, 0x7f, 0x1f, 0x00, 0x00       ;D
    db 0x00, 0x00, 0x00, 0x00, 0x00, 0x00, 0x00, 0x00       ;'left
    db 0xf8, 0xfe, 0xcf, 0xc3, 0xc0, 0xc0, 0x00, 0x00       ;2
    db 0x1f, 0x7f, 0xf0, 0xf0, 0x7f, 0x1f, 0x00, 0x00       ;0
    db 0x00, 0x00, 0x00, 0x00, 0x00, 0x00, 0x00, 0x00       ;'right
    db 0x00, 0xe0, 0xfc, 0x3f, 0x0f, 0x00, 0x00, 0x00       ;)
    db 0x00, 0x00, 0x00, 0x00, 0x00, 0x00, 0x00, 0x00       ;space
    db 0x00, 0x00, 0x00, 0x00, 0x00, 0x00, 0x00, 0x00       ;space

;Message NULL 
table_NULL
    ;Data tables for NULL message
    db 0x00, 0x00, 0x00, 0x00, 0x00, 0x00, 0x00, 0x00       ;
    db 0x00, 0x00, 0x00, 0x00, 0x00, 0x00, 0x00, 0x00       ;null frame

;Message arrow
table_arrow_C_data
    ;Data tables for message arrow upper part
    db 0x00, 0x02, 0x72, 0x1a, 0x0e, 0x06, 0x06, 0x3e
    db 0x00, 0x04, 0x84, 0x8c, 0x98, 0xf0, 0xfe, 0x00
    db 0x00, 0x00, 0x80, 0xb1, 0x89, 0x09, 0x0e, 0x06
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    db 0x00, 0x04, 0x84, 0x8c, 0x98, 0xf0, 0xfe, 0x00       ;frame 8

table_arrow_D_data
    ;Data tables for message arrow lower part
    db 0x00, 0x7e, 0x0f, 0x19, 0x31, 0x21, 0x20, 0x00
    db 0x7c, 0x60, 0x60, 0x70, 0x58, 0x4e, 0x40, 0x00
    db 0x38, 0x07, 0x07, 0x1c, 0x20, 0x01, 0x70, 0xc8
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    db 0x7c, 0x60, 0x60, 0x70, 0x58, 0x4e, 0x40, 0x00       ;frame 8

;Message hourglass
table_hourglass_C_data
    ;Data tables for message hourglass upper part
    db 0x00, 0x00, 0x03, 0x03, 0x3f, 0x7f, 0xff, 0xff
    db 0xff, 0xff, 0x7f, 0x3f, 0x03, 0x03, 0x00, 0x00
    db 0x00, 0x00, 0x03, 0x03, 0x3f, 0x6b, 0xd5, 0xab
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    db 0xff, 0xff, 0x7f, 0x3f, 0x03, 0x03, 0x00, 0x00       ;frame 24

table_hourglass_D_data
    ;Data tables for message hourglass lower part
    db 0x00, 0x00, 0xc0, 0xc0, 0xfc, 0x86, 0x83, 0x81
    db 0x81, 0x83, 0x86, 0xfc, 0xc0, 0xc0, 0x00, 0x00
    db 0x00, 0x00, 0xc0, 0xc0, 0xfc, 0x86, 0x83, 0x81
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    db 0x81, 0x83, 0x86, 0xfc, 0xc0, 0xc0, 0x00, 0x00       ;frame 24

END